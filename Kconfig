## src/Kconfig
```kconfig
menu "FreeRTOS"

config FREERTOS
    bool "Include FreeRTOS"
    default n

endmenu

menu "MIDI"

config MIDI
    bool "Enable MIDI"
    default n

config MIDI_UART
    int "UART instance used by MIDI"
    default 1

endmenu

menu "Sequencer"

config SEQUENCER
    bool "Enable sequencer"
    default n

config PPQN
    int "PPQN"
    default 96
    depends on SEQUENCER

config MAX_SEQUENCE_LENGTH
    int "Max sequence length"
    default 64
    depends on SEQUENCER

endmenu

menu "UART"

config UART
    bool "Enable UART"
    default n

config UART_SEND_TIMEOUT
    int "UART send timeout"
    default 10000
    depends on UART

config STLINK_UART
    int "UART instance used by ST-LINK"
    default 3
    depends on UART

config PRINT_UART
    int "UART instance used by print()"
    default 3
    depends on UART

endmenu
```
